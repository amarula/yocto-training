## labs/meta-training/conf/layer.conf
```bitbake
# We have a conf and classes directory, add to BBPATH
BBPATH .= ":${LAYERDIR}"

# Recipes and bbappends
BBFILES += "${LAYERDIR}/recipes-*/*/*.bb \
            ${LAYERDIR}/recipes-*/*/*.bbappend"

BBFILE_COLLECTIONS += "meta-training"
BBFILE_PATTERN_meta-training = "^${LAYERDIR}/"
BBFILE_PRIORITY_meta-training = "10"

LAYERDEPENDS_meta-training = "core"
LAYERSERIES_COMPAT_meta-training = "wrynose"
```
